## conf/distro/ebaz4205.conf
```bitbake
require conf/distro/poky.conf
require conf/distro/include/ebaz4205-features.conf
require conf/distro/include/ebaz4205-mirrors.conf

DISTRO = "ebaz4205"
DISTRO_NAME = "EBAZ4205 Generic"
DISTRO_VERSION = "${XILINX_VER_MAIN}"
SDK_VENDOR = "-ebaz4205linux"
SDK_VERSION := "${@'${DISTRO_VERSION}'.replace('snapshot-${DATE}','snapshot')}"

MAINTAINER = "Alex <alexlargacha@gmail.com>"

TARGET_VENDOR = "-ebaz4205linux"

SANITY_TESTED_DISTROS_append = " \
	ubuntu-16.04 \n \
	centos-7.2 \n \
	rhel-7.2 \n \
	rhel-7.3 \n \
	rhel-7.4 \n \
	rhel-7.5 \n \
	"

# Blacklist packages
INHERIT += "blacklist"
PNBLACKLIST[distro-feed-configs]  = "Not supported"

INHERIT += "buildhistory"
BUILDHISTORY_COMMIT = "1"

#INHERIT += "archiver"

COPY_LIC_MANIFEST = "1"
LICENSE_CREATE_PACKAGE = "1"
BB_GENERATE_MIRROR_TARBALLS = "1"

CONNECTIVITY_CHECK_URIS = ""
```

## conf/layer.conf
```bitbake
# We have a conf and classes directory, add to BBPATH
BBPATH .= ":${LAYERDIR}"

# We have recipes-* directories, add to BBFILES
BBFILES += "${LAYERDIR}/recipes-*/*/*.bb \
            ${LAYERDIR}/recipes-*/*/*.bbappend"

BBFILE_COLLECTIONS += "meta-voidasterisk"
BBFILE_PATTERN_meta-voidasterisk = "^${LAYERDIR}/"
BBFILE_PRIORITY_meta-voidasterisk = "5"

LAYERDEPENDS_meta-voidasterisk = "core"
LAYERDEPENDS_meta-voidasterisk = "xilinx"
LAYERDEPENDS_meta-voidasterisk = "xilinx-tools"

SIGGEN_EXCLUDERECIPES_ABISAFE += " \
    gcc-cross-xilinx \
    binutils-cross-xilinx \
    "

BB_DANGLINGAPPENDS_WARNONLY = "true"

LAYERSERIES_COMPAT_meta-voidasterisk = "thud"
```

## conf/machine/ebaz4205.conf
```bitbake
#@TYPE: Machine
#@NAME: EBAZ4205
#@DESCRIPTION: Machine support for EBAZ4205 Board.
#

SOC_VARIANT ?= "7z"

require conf/machine/include/tune-cortexa9.inc

# u-boot configuration
UBOOT_MACHINE = "zynq_ebaz4205_defconfig"
SPL_BINARY ?= "spl/boot.bin"

EXTRA_IMAGEDEPENDS += " \
		u-boot-zynq-uenv \
		virtual/boot-bin \
		virtual/bootloader \
		"

SERIAL_CONSOLE = "115200 ttyPS0"

IMAGE_BOOT_FILES += " \
		boot.bin \
		uEnv.txt \
		"
```
